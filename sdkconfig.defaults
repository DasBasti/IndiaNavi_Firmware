## sdkconfig.defaults.esp32
```kconfig
# ESP32 (esp32dev), see sdkconfig.defaults

CONFIG_ESP_BROWNOUT_DET_LVL_SEL_5=y
CONFIG_ESP_DEFAULT_CPU_FREQ_MHZ_240=y
CONFIG_ESP_HTTP_CLIENT_ENABLE_DIGEST_AUTH=y
CONFIG_ESP_SLEEP_POWER_DOWN_FLASH=y
CONFIG_ESP_WIFI_STA_DISCONNECTED_PM_ENABLE=n
CONFIG_FREERTOS_IDLE_TASK_STACKSIZE=2304
CONFIG_FREERTOS_VTASKLIST_INCLUDE_COREID=y
CONFIG_PM_DFS_INIT_AUTO=y
```
